## conf/layer.conf
```bitbake
# We might have a conf and classes directory, append to BBPATH
BBPATH .= ":${LAYERDIR}"

# We have a recipes directory, add to BBFILES
BBFILES += "${LAYERDIR}/recipes*/*/*.bb ${LAYERDIR}/recipes*/*/*.bbappend"

BBFILE_COLLECTIONS += "meta-circuitco"
BBFILE_PATTERN_meta-circuitco := "^${LAYERDIR}/"
BBFILE_PRIORITY_meta-circuitco = "8"
```
